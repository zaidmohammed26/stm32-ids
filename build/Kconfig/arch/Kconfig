## build/Kconfig/arch/Kconfig
```kconfig
# Load Zephyr Arch Kconfig descriptions.
osource "/home/zaid/zephyrproject/zephyr/arch/rx/Kconfig"
osource "/home/zaid/zephyrproject/zephyr/arch/x86/Kconfig"
osource "/home/zaid/zephyrproject/zephyr/arch/xtensa/Kconfig"
osource "/home/zaid/zephyrproject/zephyr/arch/sparc/Kconfig"
osource "/home/zaid/zephyrproject/zephyr/arch/riscv/Kconfig"
osource "/home/zaid/zephyrproject/zephyr/arch/posix/Kconfig"
osource "/home/zaid/zephyrproject/zephyr/arch/mips/Kconfig"
osource "/home/zaid/zephyrproject/zephyr/arch/arm64/Kconfig"
osource "/home/zaid/zephyrproject/zephyr/arch/arm/Kconfig"
osource "/home/zaid/zephyrproject/zephyr/arch/arc/Kconfig"
```

## build/Kconfig/boards/Kconfig
```kconfig
# Load Zephyr board Kconfig descriptions.
osource "/home/zaid/zephyrproject/zephyr/boards/st/nucleo_f767zi/Kconfig"
```

## build/Kconfig/boards/Kconfig.nucleo_f767zi
```kconfig
# Load board Kconfig descriptions.
osource "/home/zaid/zephyrproject/zephyr/boards/st/nucleo_f767zi/Kconfig.nucleo_f767zi"
```
